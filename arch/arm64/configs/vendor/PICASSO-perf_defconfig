## arch/arm64/configs/vendor/PICASSO-perf_defconfig
```kconfig
###############################################################################################
#
# Reverse the order of the configs for the override to work properly
# Correct order is : 
#1.base_defconfig : kernel/msm-5.4/arch/arm64/configs/gki_defconfig 
#2.GKI.config : /kernel/msm-5.4/arch/arm64/configs/vendor/lahaina_GKI.config (GKI.config)
#3.QGKI.config : /kernel/msm-5.4/arch/arm64/configs/vendor/lahaina_QGKI.config  (QGKI.config)
#4.Consolidate.config : /kernel/msm-5.4/arch/arm64/configs/vendor/lahaina_consolidate.config
#5.debug.config : kernel/msm-5.4/arch/arm64/configs/vendor/lahaina_debug.config  (debug.config)
#6.asus_defconfig : kernel/msm-5.4/arch/arm64/configs/vendor/PICASSO_defconfig
#
###############################################################################################
CONFIG_LOCALVERSION="picasso-qgki-perf"
CONFIG_MACH_ASUS_PICASSO=y
CONFIG_TOUCHSCREEN_ROG=m
# CONFIG_TOUCHSCREEN_ST is not set
# CONFIG_TOUCHSCREEN_FTS is not set
CONFIG_NETFILTER_XT_TARGET_LOG=y
CONFIG_NETFILTER_XT_MATCH_MULTIPORT=y
CONFIG_INPUT_SX932X=m
CONFIG_INPUT_SX932X_2ND=m
CONFIG_TSPDRV=n
CONFIG_INPUT_HALLSENSOR=m
CONFIG_INPUT_HALLSENSOR2=m
# ASUS_BSP : Support PD_RT1715 +++
CONFIG_RT_REGMAP=y
CONFIG_TCPC_CLASS=y
CONFIG_USB_POWER_DELIVERY=y
CONFIG_TCPC_RT1711H=y
# ASUS_BSP : Support PD_RT1715 ---
CONFIG_MSM_QBT_HANDLER=m

##########################################
# user version config...
##########################################

CONFIG_CORESIGHT=y
CONFIG_CORESIGHT_LINKS_AND_SINKS=y
CONFIG_CORESIGHT_LINK_AND_SINK_TMC=y
CONFIG_CORESIGHT_SOURCE_ETM4X=y
CONFIG_CORESIGHT_DYNAMIC_REPLICATOR=y
CONFIG_CORESIGHT_STM=y
CONFIG_CORESIGHT_CTI=y
CONFIG_CORESIGHT_OST=y
CONFIG_CORESIGHT_TPDA=y
CONFIG_CORESIGHT_TPDM=y
CONFIG_CORESIGHT_HWEVENT=y
CONFIG_CORESIGHT_DUMMY=y
CONFIG_CORESIGHT_REMOTE_ETM=y
CONFIG_CORESIGHT_REMOTE_ETM_DEFAULT_ENABLE=0
CONFIG_CORESIGHT_CSR=y
CONFIG_CORESIGHT_TGU=y
CONFIG_CORESIGHT_EVENT=y
CONFIG_CORESIGHT_QGKI=y
CONFIG_CORESIGHT_CTI_SAVE_DISABLE=y
CONFIG_QCOM_QDSS_BRIDGE=y

CONFIG_USB_F_QDSS = y
CONFIG_USB_CONFIGFS_F_QDSS=y
CONFIG_DEBUG_ALIGN_RODATA=y
CONFIG_MSM_REMOTEQDSS=y

CONFIG_CMA_DEBUG=n
CONFIG_CMA_DEBUGFS=n
CONFIG_REGMAP_QTI_DEBUG=n
CONFIG_REGMAP_ALLOW_WRITE_DEBUGFS=n
CONFIG_MHI_DEBUG=n
CONFIG_CNSS2_DEBUG=n
CONFIG_SPMI_MSM_PMIC_ARB_DEBUG=n
CONFIG_SPMI_QTI_GLINK_DEBUG=n
CONFIG_REGULATOR_QTI_DEBUG=n
CONFIG_MSM_GPI_DMA_DEBUG=n
#CONFIG_COMMON_CLK_QCOM_DEBUG=n
CONFIG_MSM_DEBUGCC_LAHAINA=n
CONFIG_SM_DEBUGCC_SHIMA=n
CONFIG_IOMMU_TLBSYNC_DEBUG=n
CONFIG_IOMMU_DEBUG=n
CONFIG_QMP_DEBUGFS_CLIENT=n
CONFIG_QTI_PMIC_GLINK_CLIENT_DEBUG=n
CONFIG_QTI_BATTERY_GLINK_DEBUG=n
CONFIG_DYNAMIC_DEBUG=n
CONFIG_SERIAL_MSM_GENI_CONSOLE=n
CONFIG_DEBUG_CONSOLE_UNHASHED_POINTERS=n
CONFIG_DEBUG_INFO=n
CONFIG_DEBUG_PAGEALLOC=n
CONFIG_DEBUG_PANIC_ON_OOM=n
CONFIG_DEBUG_PAGEALLOC_ENABLE_DEFAULT=n
# CONFIG_DEBUG_PREEMPT is not set
CONFIG_DEBUG_SPINLOCK=n
CONFIG_QCOM_WDT_CORE=n


CONFIG_QCOM_RTB=y
CONFIG_QCOM_RTB_QGKI=y
CONFIG_QCOM_RTB_SEPARATE_CPUS=y


CONFIG_SLUB_DEBUG_PANIC_ON=n
CONFIG_IO_PGTABLE_PAGE_ACCOUNTING=n
CONFIG_SLUB_DEBUG_ON=n
CONFIG_DEBUG_KMEMLEAK=n
CONFIG_DEBUG_KMEMLEAK_EARLY_LOG_SIZE=4000
CONFIG_DEBUG_KMEMLEAK_DEFAULT_OFF=n
CONFIG_PAGE_POISONING=n
CONFIG_PAGE_POISONING_ENABLE_DEFAULT=n
CONFIG_DEBUG_STACK_USAGE=n
CONFIG_DEBUG_MEMORY_INIT=n
CONFIG_KPROBES=n
CONFIG_QTI_SYS_PM_VX=n
```

## arch/arm64/configs/vendor/SAKE-perf_defconfig
```kconfig
###############################################################################################
#
# Reverse the order of the configs for the override to work properly
# Correct order is : 
#1.base_defconfig : kernel/msm-5.4/arch/arm64/configs/gki_defconfig 
#2.GKI.config : /kernel/msm-5.4/arch/arm64/configs/vendor/lahaina_GKI.config (GKI.config)
#3.QGKI.config : /kernel/msm-5.4/arch/arm64/configs/vendor/lahaina_QGKI.config  (QGKI.config)
#4.Consolidate.config : /kernel/msm-5.4/arch/arm64/configs/vendor/lahaina_consolidate.config
#5.debug.config : kernel/msm-5.4/arch/arm64/configs/vendor/lahaina_debug.config  (debug.config)
#6.asus_defconfig : kernel/msm-5.4/arch/arm64/configs/vendor/SAKE_defconfig
#
###############################################################################################
CONFIG_LOCALVERSION="-qgki-perf"
CONFIG_MACH_ASUS_SAKE=y
CONFIG_TOUCHSCREEN_FTS_ZF=m
# CONFIG_TOUCHSCREEN_ST is not set
# CONFIG_TOUCHSCREEN_FTS is not set
CONFIG_GOODIX_FINGERPRINT_2ND=m
CONFIG_SLA_STAIC_COLLECT=y
CONFIG_SLA=m
CONFIG_NETFILTER_XT_TARGET_LOG=y
CONFIG_NETFILTER_XT_MATCH_MULTIPORT=y
CONFIG_AW8697_HAPTIC=m
CONFIG_I2C_RTC6226_QCA=y
CONFIG_INPUT_QCOM_HV_HAPTICS=n
CONFIG_INPUT_SX932X_SAKE=m
CONFIG_ASUS_POWER_DEBUG=y
CONFIG_CGF_NOTIFY_EVENT=y
CONFIG_USB_ANNOUNCE_NEW_DEVICES=y

#add configs to user build
CONFIG_SPMI_MSM_PMIC_ARB_DEBUG=n
CONFIG_MSM_GPI_DMA_DEBUG=n
CONFIG_MSM_DEBUGCC_LAHAINA=n
CONFIG_SM_DEBUGCC_SHIMA=n
CONFIG_IOMMU_TLBSYNC_DEBUG=n
CONFIG_QTI_BATTERY_GLINK_DEBUG=n
CONFIG_SERIAL_MSM_GENI_CONSOLE=n
#CONFIG_QCOM_WDT_CORE=n
CONFIG_STM=n
CONFIG_DEBUG_STACK_USAGE=n
CONFIG_DEBUG_MEMORY_INIT=n

CONFIG_QCOM_RTB=y
CONFIG_QCOM_RTB_QGKI=y
CONFIG_QCOM_RTB_SEPARATE_CPUS=y

CONFIG_KPROBES=n

CONFIG_CORESIGHT=y
CONFIG_CORESIGHT_LINKS_AND_SINKS=y
CONFIG_CORESIGHT_LINK_AND_SINK_TMC=y
CONFIG_CORESIGHT_SOURCE_ETM4X=y
CONFIG_CORESIGHT_DYNAMIC_REPLICATOR=y
CONFIG_CORESIGHT_STM=y
CONFIG_CORESIGHT_CTI=y
CONFIG_CORESIGHT_OST=y
CONFIG_CORESIGHT_TPDA=y
CONFIG_CORESIGHT_TPDM=y
CONFIG_CORESIGHT_HWEVENT=y
CONFIG_CORESIGHT_DUMMY=y
CONFIG_CORESIGHT_REMOTE_ETM=y
CONFIG_CORESIGHT_REMOTE_ETM_DEFAULT_ENABLE=0
CONFIG_CORESIGHT_CSR=y
CONFIG_CORESIGHT_TGU=y
CONFIG_CORESIGHT_EVENT=y
CONFIG_CORESIGHT_QGKI=y
CONFIG_CORESIGHT_CTI_SAVE_DISABLE=y
CONFIG_QCOM_QDSS_BRIDGE=y

CONFIG_USB_F_QDSS = y
CONFIG_USB_CONFIGFS_F_QDSS=y
CONFIG_DEBUG_ALIGN_RODATA=y
CONFIG_MSM_REMOTEQDSS=y

CONFIG_QCOM_EUD=n

#disable below config to improve perf
CONFIG_SLUB_DEBUG=n
CONFIG_SPMI_QTI_GLINK_DEBUG=n
CONFIG_DYNAMIC_DEBUG_CORE=n
CONFIG_DEBUG_MISC=n
CONFIG_DEBUG_BUGVERBOSE=n
CONFIG_DEBUG_LIST=n
CONFIG_IPC_LOGGING=n
CONFIG_SERIAL_EARLYCON=n
CONFIG_SERIAL_8250_CONSOLE=n
CONFIG_SERIAL_SAMSUNG_CONSOLE=n
CONFIG_SERIAL_CORE_CONSOLE=n

#disable below config to improve memory
CONFIG_MEMORY_HOTPLUG=n
CONFIG_MEMORY_HOTPLUG_DEFAULT_ONLINE=n
CONFIG_MEMORY_HOTPLUG_MOVABLE_NODE=n
CONFIG_OVERRIDE_MEMORY_LIMIT=n
CONFIG_HOTPLUG_SIZE_BITS=n
CONFIG_MEMORY_HOTREMOVE=n
CONFIG_QCOM_MEM_OFFLINE=n

CONFIG_SONY_FF=y
CONFIG_HID_PLAYSTATION=y
CONFIG_PLAYSTATION_FF=y
```

## arch/arm64/configs/vendor/SAKE_defconfig
```kconfig
###############################################################################################
#
# Reverse the order of the configs for the override to work properly
# Correct order is : 
#1.base_defconfig : kernel/msm-5.4/arch/arm64/configs/gki_defconfig 
#2.GKI.config : /kernel/msm-5.4/arch/arm64/configs/vendor/lahaina_GKI.config (GKI.config)
#3.QGKI.config : /kernel/msm-5.4/arch/arm64/configs/vendor/lahaina_QGKI.config  (QGKI.config)
#4.Consolidate.config : /kernel/msm-5.4/arch/arm64/configs/vendor/lahaina_consolidate.config
#5.debug.config : kernel/msm-5.4/arch/arm64/configs/vendor/lahaina_debug.config  (debug.config)
#6.asus_defconfig : kernel/msm-5.4/arch/arm64/configs/vendor/SAKE_defconfig
#
###############################################################################################
CONFIG_LOCALVERSION="-qgki-debug"
CONFIG_MACH_ASUS_SAKE=y
CONFIG_TOUCHSCREEN_FTS_ZF=m
# CONFIG_TOUCHSCREEN_ST is not set
# CONFIG_TOUCHSCREEN_FTS is not set
CONFIG_GOODIX_FINGERPRINT_2ND=m
CONFIG_SLA_STAIC_COLLECT=y
CONFIG_SLA=m
CONFIG_NETFILTER_XT_TARGET_LOG=y
CONFIG_NETFILTER_XT_MATCH_MULTIPORT=y
CONFIG_AW8697_HAPTIC=m
CONFIG_I2C_RTC6226_QCA=y
CONFIG_INPUT_QCOM_HV_HAPTICS=n
CONFIG_INPUT_SX932X_SAKE=m
CONFIG_CGF_NOTIFY_EVENT=y
CONFIG_USB_ANNOUNCE_NEW_DEVICES=y
CONFIG_EDAC_KRYO_ARM64_PANIC_ON_CE=n

CONFIG_QCOM_EUD=n

CONFIG_SONY_FF=y
CONFIG_HID_PLAYSTATION=y
CONFIG_PLAYSTATION_FF=y
```

## arch/arm64/configs/vendor/VODKA-perf_defconfig
```kconfig
###############################################################################################
#
# Reverse the order of the configs for the override to work properly
# Correct order is : 
#1.base_defconfig : kernel/msm-5.4/arch/arm64/configs/gki_defconfig 
#2.GKI.config : /kernel/msm-5.4/arch/arm64/configs/vendor/lahaina_GKI.config (GKI.config)
#3.QGKI.config : /kernel/msm-5.4/arch/arm64/configs/vendor/lahaina_QGKI.config  (QGKI.config)
#4.Consolidate.config : /kernel/msm-5.4/arch/arm64/configs/vendor/lahaina_consolidate.config
#5.debug.config : kernel/msm-5.4/arch/arm64/configs/vendor/lahaina_debug.config  (debug.config)
#6.asus_defconfig : kernel/msm-5.4/arch/arm64/configs/vendor/VODKA_defconfig
#
###############################################################################################
CONFIG_LOCALVERSION="-qgki-perf"
CONFIG_MACH_ASUS_VODKA=y
CONFIG_TOUCHSCREEN_FTS_ZF=m
# CONFIG_TOUCHSCREEN_ST is not set
# CONFIG_TOUCHSCREEN_FTS is not set
CONFIG_SLA_STAIC_COLLECT=y
CONFIG_SLA=m
CONFIG_NETFILTER_XT_TARGET_LOG=y
CONFIG_NETFILTER_XT_MATCH_MULTIPORT=y
CONFIG_GOODIX_FINGERPRINT_2ND=m
CONFIG_LATCH_AK09973=m
CONFIG_LATCH_SENSOR=m
CONFIG_HALL_SENSOR=m
CONFIG_INPUT_SX932X_VODKA=m
CONFIG_ASUS_POWER_DEBUG=y
CONFIG_CGF_NOTIFY_EVENT=y
CONFIG_USB_ANNOUNCE_NEW_DEVICES=y

#add configs to user build
CONFIG_SPMI_MSM_PMIC_ARB_DEBUG=n
CONFIG_MSM_GPI_DMA_DEBUG=n
CONFIG_MSM_DEBUGCC_LAHAINA=n
CONFIG_SM_DEBUGCC_SHIMA=n
CONFIG_IOMMU_TLBSYNC_DEBUG=n
CONFIG_QTI_BATTERY_GLINK_DEBUG=n
CONFIG_SERIAL_MSM_GENI_CONSOLE=n
#CONFIG_QCOM_WDT_CORE=n
CONFIG_STM=n
CONFIG_DEBUG_STACK_USAGE=n
CONFIG_DEBUG_MEMORY_INIT=n

CONFIG_QCOM_RTB=y
CONFIG_QCOM_RTB_QGKI=y
CONFIG_QCOM_RTB_SEPARATE_CPUS=y

CONFIG_KPROBES=n

CONFIG_CORESIGHT=y
CONFIG_CORESIGHT_LINKS_AND_SINKS=y
CONFIG_CORESIGHT_LINK_AND_SINK_TMC=y
CONFIG_CORESIGHT_SOURCE_ETM4X=y
CONFIG_CORESIGHT_DYNAMIC_REPLICATOR=y
CONFIG_CORESIGHT_STM=y
CONFIG_CORESIGHT_CTI=y
CONFIG_CORESIGHT_OST=y
CONFIG_CORESIGHT_TPDA=y
CONFIG_CORESIGHT_TPDM=y
CONFIG_CORESIGHT_HWEVENT=y
CONFIG_CORESIGHT_DUMMY=y
CONFIG_CORESIGHT_REMOTE_ETM=y
CONFIG_CORESIGHT_REMOTE_ETM_DEFAULT_ENABLE=0
CONFIG_CORESIGHT_CSR=y
CONFIG_CORESIGHT_TGU=y
CONFIG_CORESIGHT_EVENT=y
CONFIG_CORESIGHT_QGKI=y
CONFIG_CORESIGHT_CTI_SAVE_DISABLE=y
CONFIG_QCOM_QDSS_BRIDGE=y

CONFIG_USB_F_QDSS = y
CONFIG_USB_CONFIGFS_F_QDSS=y
CONFIG_DEBUG_ALIGN_RODATA=y
CONFIG_MSM_REMOTEQDSS=y

CONFIG_SONY_FF=y
CONFIG_HID_PLAYSTATION=y
CONFIG_PLAYSTATION_FF=y
```

## drivers/input/fingerprint2nd/Kconfig
```kconfig
config GOODIX_FINGERPRINT_2ND
	tristate "generic goodix fingerprint driver"
	depends on MACH_ASUS_SAKE || MACH_ASUS_VODKA
	default m
	help
	   add support for goodix fingerprint driver.
```

## drivers/input/touchscreen/Sake_TP_3658U/Kconfig
```kconfig
#
# Focaltech Touchscreen driver configuration
#

config TOUCHSCREEN_FTS_ZF
    tristate "Focaltech Touchscreen"
    depends on MACH_ASUS_SAKE
    help
      Say Y here if you have Focaltech touch panel.
      If unsure, say N.
      
config TOUCHSCREEN_FTS_DIRECTORY
    string "Focaltech ts directory name"
    default "focaltech_touch_zf"
    depends on TOUCHSCREEN_FTS_ZF
    
```

## drivers/input/touchscreen/focaltech_touch_v3_3/Kconfig
```kconfig
#
# Focaltech Touchscreen driver configuration
#

config TOUCHSCREEN_FTS_V3_3
	tristate "Focaltech Touchscreen"
	help
	  Say Y here if you have Focaltech touch panel.
	  If unsure, say N.
```

## drivers/misc/hall_sensor/Kconfig
```kconfig
config HALL_SENSOR
    tristate "Hall sensor driver"
	---help---
	 Say y here if you want to use this hall sensor driver, it
	 can get magnetic data form xyz-axis.
```

## drivers/misc/latch_ak09973/Kconfig
```kconfig
config LATCH_AK09973
    tristate "Latch ak09973 driver"
    depends on I2C
	---help---
	 Say y here if you want to use this hall sensor driver, it
	 can get magnetic data form xyz-axis.
```

## drivers/misc/latch_sensor/Kconfig
```kconfig
config LATCH_SENSOR
    tristate "Latch sensor driver"
    depends on I2C
	---help---
	 Say y here if you want to use this hall sensor driver, it
	 can get magnetic data form xyz-axis.
```

## drivers/sensors/Kconfig
```kconfig
# SPDX-License-Identifier: GPL-2.0-only
config SENSORS_ICM206XX
	tristate "ICM206XX 6-axis gyroscope and acceleromater combo"
	depends on INPUT && SPI
	help
	  Say Y here if you want to support InvenSense ICM206XX
	  connected via an I2C bus.

	  To compile this driver as a module, choose M here: the
	  module will be called ICM206XX.
	  
config SENSORS_ALSPS
	tristate "ALSPS sensor for light and proximity"
	default m
	help
	  Say Y here if you want to support ALSPS
	  connected via an I2C bus.

	  To compile this driver as a module, choose M here: the
	  module will be called ALSPS.

config SENSORS_SNT8155
	tristate "SNT8155 grip sensor for game gesture"
	depends on MACH_ASUS_ZS673KS
	default m
	help
	  Say Y here if you want to support InvenSense SNT8155
	  connected via an I2C bus.

	  To compile this driver as a module, choose M here: the
	  module will be called SNT8155.
```
